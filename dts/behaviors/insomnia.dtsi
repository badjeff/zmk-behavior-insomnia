/*
 * Copyright (c) 2025 The ZMK Contributors
 *
 * SPDX-License-Identifier: MIT
 */

#include <dt-bindings/zmk/behaviors.h>
#include <dt-bindings/zmk/keys.h>

/ {
    behaviors {
        // /omit-if-no-ref/ 
        isa: insomnia {
            compatible = "zmk,behavior-insomnia";
            #binding-cells = <1>;
            sleep-delay-ms = <1500>;
            display-name = "Insomnia";
        };
    };
};
